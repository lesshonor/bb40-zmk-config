## config/boards/shields/bb40/Kconfig.defconfig
```kconfig
# Copyright (c) 2023 The ZMK Contributors
# SPDX-License-Identifier: MIT

if SHIELD_BB40

config ZMK_KEYBOARD_NAME
    default "BB40"

config ZMK_SLEEP
    depends on ZMK_BOARD_PILLBUG

if ZMK_BACKLIGHT

config PWM
    default y if DT_HAS_PWM_LEDS_ENABLED

config LED_PWM
    default y if DT_HAS_PWM_LEDS_ENABLED

config LED_GPIO
    default n if DT_HAS_PWM_LEDS_ENABLED

endif

endif
```
